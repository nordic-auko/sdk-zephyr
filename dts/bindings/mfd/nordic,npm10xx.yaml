## dts/bindings/mfd/nordic,npm10xx.yaml
```yaml
# Copyright (c) 2026 Nordic Semiconductor
# SPDX-License-Identifier: Apache-2.0

description: Nordic nPM10xx PMIC MFD

include: i2c-device.yaml

compatible: "nordic,npm10xx"

properties:
  host-int-gpios:
    type: phandle-array
    description: |
      Host GPIO for interrupt input. Active level must match that of pmic-int-gpio-config.

  pmic-int-gpio-config:
    type: array
    description: |
      PMIC GPIO config for interrupt output <idx flags>. Index is 0 to 2. Use flags to provide
      additional configuration, for example, GPIO_OPEN_DRAIN.
```
